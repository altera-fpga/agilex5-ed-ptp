## a5e065a-prem-devkit-exp-prod/src/sw/yocto/meta-agilex5-sed/conf/layer.conf
```bitbake
# We have a conf and classes directory, add to BBPATH
BBPATH .= ":${LAYERDIR}"
INHERIT += "buildhistory"
BUILDHISTORY_COMMIT = "1"

# We have recipes-* directories, add to BBFILES
BBFILES += "${LAYERDIR}/recipes-*/*/*.bb ${LAYERDIR}/recipes-*/*/*.bbappend"

BBFILE_COLLECTIONS += "agilex5-sed"
BBFILE_PATTERN_agilex5-sed = "^${LAYERDIR}/"
BBFILE_PRIORITY_agilex5-sed = "21"

# This should only be incremented on significant changes that will
# cause compatibility issues with other layers
LAYERVERSION_agilex5-sed = "1"

LAYERDEPENDS_agilex5-sed = "core meta-intel-fpga-refdes meta-intel-fpga"

LAYERSERIES_COMPAT_agilex5-sed = "master scarthgap"
BBDEBUG = "yes"
```
